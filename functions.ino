//anim
static const uint8_t image_data_feed1[512] = {
    0x00, 0x00, 0x10, 0x00, 0x00, 0x04, 0x00, 0x00, 
    0x00, 0x00, 0x10, 0x00, 0x00, 0x04, 0x00, 0x00, 
    0x00, 0x00, 0x10, 0x00, 0x00, 0x04, 0x00, 0x00, 
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    0x00, 0x00, 0x00, 0x00, 0x00, 0x00, 0x00, 0x00
};
static const uint8_t image_data_feed2[512] = {
    0x00, 0x00, 0x10, 0x00, 0x00, 0x04, 0x00, 0x00, 
    0x00, 0x00, 0x10, 0x00, 0x00, 0x04, 0x00, 0x00, 
    0x00, 0x00, 0x10, 0x00, 0x00, 0x04, 0x00, 0x00, 
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    0x00, 0x00, 0x00, 0x00, 0x00, 0x00, 0x00, 0x00
};
static const uint8_t image_data_feed3[512] = {
    0x00, 0x00, 0x10, 0x00, 0x00, 0x04, 0x00, 0x00, 
    0x00, 0x00, 0x10, 0x00, 0x00, 0x04, 0x00, 0x00, 
    0x00, 0x00, 0x10, 0x00, 0x00, 0x04, 0x00, 0x00, 
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    0x00, 0x00, 0x00, 0x00, 0x00, 0x00, 0x00, 0x00
};
static const uint8_t image_data_feed4[512] = {
    0x00, 0x00, 0x10, 0x00, 0x00, 0x04, 0x00, 0x00, 
    0x00, 0x00, 0x10, 0x00, 0x00, 0x04, 0x00, 0x00, 
    0x00, 0x00, 0x10, 0x00, 0x00, 0x04, 0x00, 0x00, 
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    0x00, 0x00, 0x00, 0x00, 0x00, 0x00, 0x00, 0x00
};
void feed() {
  byte anim_n=feedAmount/4;
  for (int i = 0; i < feedAmount; i++) {
    display.setCursor(0,0);
    display.clearDisplay();
    if (i<anim_n) {
      display.drawBitmap(32,0,image_data_feed1,64,64,1);
    }
    if (i>=anim_n and i<2*anim_n){
     display.drawBitmap(32,0,image_data_feed2,64,64,1); 
    }
    if (i>=2*anim_n and i<3*anim_n){
      display.drawBitmap(32,0,image_data_feed3,64,64,1);  
    }
    if (i>=3*anim_n){
      display.drawBitmap(32,0,image_data_feed4,64,64,1); 
    }
    display.println(i);
    oneRev();
    display.display();
    // rotate the engine by feedAmount
  }
  
  disableMotor();
  draw_display();
}

void disableMotor() {
  for (byte i = 0; i < 4; i++) digitalWrite(drvPins[i], 0); // turn off the power to the engine
}

void oneRev() {
  yield();              // to avoid soft WDT reset
  static byte val = 0;
  for (byte i = 0; i < STEPS_BKW; i++) runMotor(val--);
  for (byte i = 0; i < STEPS_FRW; i++) runMotor(val++);
}

void runMotor(byte thisStep) {
  static const byte steps[] = {0b1010, 0b0110, 0b0101, 0b1001};
  for (byte i = 0; i < 4; i++)
    digitalWrite(drvPins[i], bitRead(steps[thisStep & 0b11], i));
  delayMicroseconds(FEED_SPEED);
}


void buttons_check(){
  btn.tick();
   btn2.tick();
if (low_bright==true){
if (btn.click() or btn2.click()){
    if (scr_off_ms > 0) reduceBright.start();
    if (low_bright==true){
      low_bright=false;
      display.dim(low_bright);
    }
   }   
}
 switch (WorkMode) {
  
 
 case 0:  if (btn.click()) {
                        feed();
                          }

          if (btn2.click()) {
                WorkMode=1;
                display.dim(false);
                draw_display();
                            }       
                
           if (btn2.held()){
            WorkMode=2;
            draw_display();
            menuitem=0;
           }
           
                break;
case 1:         if (alarm_edit==false){
                                if (btn2.click()){
                                WorkMode=0;
                                 draw_display();
                                }

                                
                                }
                else { //режим пролистывания будильников
                          
                          if (btn.held()){
                          a_set++;
                          if (a_set>3) a_set=0;
                          draw_display();
                                            }  
                    
                     if (btn.click()){
                      switch (a_set){
                      case 3: if (menuitem>0) menuitem--; else menuitem=3;
                              break;
                      case 0: if (feedTime[menuitem][0]>0) feedTime[menuitem][0]--; else feedTime[menuitem][0]=23;
                              break;
                      case 1: if (feedTime[menuitem][1]>0) feedTime[menuitem][1]--; else feedTime[menuitem][1]=59;
                              break; 
                      case 2: if (feedTime[menuitem][2]==0) feedTime[menuitem][2]=1; else feedTime[menuitem][2]=0;
                              break;       
                                  }
                     }
                    
                    if (btn2.click()){
                      switch (a_set){
                      case 3: if (menuitem<3) menuitem++; else menuitem=0;
                              break;
                      case 0: if (feedTime[menuitem][0]<23) feedTime[menuitem][0]++; else feedTime[menuitem][0]=0;
                              break;
                      case 1: if (feedTime[menuitem][1]<59) feedTime[menuitem][1]++; else feedTime[menuitem][1]=0;
                              break; 
                      case 2: if (feedTime[menuitem][2]==0) feedTime[menuitem][2]=1; else feedTime[menuitem][2]=0;
                              break;       
                                  }
                      
                     }
                    }
                 if (btn2.held()){
                      if (alarm_edit==true){
                        saveConfig();
                      }
                      
                  a_set=3;
                 alarm_edit=!alarm_edit;
                 draw_display();
                 menuitem=0;
                                 }
                break;
                
case 2:         if (btn.click()) {
                        switch (menuitem){
                                case 0: feedAmount++;
                                        if (feedAmount>100) feedAmount=20;
                                break;
                                case 1: if (timezone<12) timezone++; else timezone=-12;
                                break;
                                case 2: if (WiFi.getMode()==WIFI_STA) StartAPMode(); else {
                                  WIFIinit();
                                  if (WiFi.status() == WL_CONNECTED){
                                      SSDP_init();
                                      MQTT_init();
                                }
                                }
                                break;
                                //case 4: Serial.println(menuitem);
                                //break;
                                        }
                         draw_display();
                          }  
  
                if (btn2.click()) {
                menuitem++;
                if (menuitem>2) menuitem=0;
                Serial.println(menuitem);
                draw_display();
                }  
                
                if (btn2.held()){
                saveConfig();
                WorkMode=0;
                SetTime();
                draw_display();
                
               }
                break;
 }
}


void SetTime(){ 
  timeClient.setTimeOffset(3600*timezone);
  if (timeClient.forceUpdate()==true) {
  byte s=timeClient.getSeconds();
  byte m=timeClient.getMinutes();
  byte h=timeClient.getHours();
  byte d=timeClient.getDay();
  rtc.gettime();
  if (m!=rtc.minutes or h!=rtc.Hours) rtc.settime(s, m, h, d);
  }
  }
